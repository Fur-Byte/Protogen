## firmware/esp32/sdkconfig.defaults
```kconfig
CONFIG_IDF_TARGET="esp32c3"
CONFIG_ESPTOOLPY_FLASHSIZE_4MB=y
CONFIG_PARTITION_TABLE_SINGLE_APP_LARGE=y
CONFIG_ESP_MAIN_TASK_STACK_SIZE=12288
CONFIG_ESP_TASK_WDT_EN=y
CONFIG_MBEDTLS_PSK_MODES=y
CONFIG_MBEDTLS_KEY_EXCHANGE_PSK=y
CONFIG_MBEDTLS_SSL_PROTO_DTLS=y
CONFIG_MBEDTLS_SSL_PROTO_TLS1_2=y
CONFIG_MBEDTLS_SSL_COOKIE_C=y
CONFIG_MBEDTLS_SSL_RENEGOTIATION=n
CONFIG_MBEDTLS_CLIENT_SSL_SESSION_TICKETS=n
CONFIG_MBEDTLS_SERVER_SSL_SESSION_TICKETS=n
CONFIG_MBEDTLS_ASYMMETRIC_CONTENT_LEN=n
CONFIG_MBEDTLS_SSL_MAX_CONTENT_LEN=1024
CONFIG_MBEDTLS_SSL_PROTO_TLS1_3=n
CONFIG_LOG_DEFAULT_LEVEL_WARN=y
CONFIG_ESP_CONSOLE_UART_DEFAULT=y
CONFIG_ESP_CONSOLE_SECONDARY_NONE=y
```

## firmware/esp32/src/Kconfig.projbuild
```kconfig
menu "Protogen production security"
config PROTOGEN_PRODUCTION
    bool "Require explicitly provisioned production hardware"
    default n
    help
        Fails compilation without Secure Boot v2, flash encryption, encrypted
        NVS and anti-rollback; rejects hardware without boot/flash protection.
        Never enable on development units. Follow PRODUCTION_PROVISIONING.md.
endmenu
```
